## boards/keremimo/eyelash_sofle/board.yml
```yaml
boards:
  - name: eyelash_sofle_left
    vendor: keremimo
    socs:
      - name: nrf52840
        variants:
          - name: zmk
  - name: eyelash_sofle_right
    vendor: keremimo
    socs:
      - name: nrf52840
        variants:
          - name: zmk
```

## boards/keremimo/eyelash_sofle/eyelash_sofle_left_defconfig
```kconfig
#
# Copyright (c) 2022 Darryl deHaan
# SPDX-License-Identifier: MIT
#

# Enable MPU
CONFIG_ARM_MPU=y

# enable pinctrl
CONFIG_PINCTRL=y

# enable GPIO
CONFIG_GPIO=y

# Enable SPI
CONFIG_SPI=y

# Enable writing to flash
CONFIG_USE_DT_CODE_PARTITION=y
CONFIG_BUILD_OUTPUT_UF2=y
CONFIG_MPU_ALLOW_FLASH_WRITE=y
CONFIG_NVS=y
CONFIG_SETTINGS_NVS=y
CONFIG_FLASH=y
CONFIG_FLASH_PAGE_LAYOUT=y
CONFIG_FLASH_MAP=y

# Enable 32kHz crystal
CONFIG_CLOCK_CONTROL_NRF_K32SRC_XTAL=y
CONFIG_CLOCK_CONTROL_NRF_K32SRC_30PPM=y

CONFIG_BT_CTLR_TX_PWR_PLUS_8=y

#EC11 enable
CONFIG_EC11=y
CONFIG_EC11_TRIGGER_GLOBAL_THREAD=y
```

## boards/keremimo/eyelash_sofle/eyelash_sofle_left_zmk_defconfig
```kconfig
CONFIG_ARM_MPU=y
CONFIG_PINCTRL=y
CONFIG_GPIO=y
CONFIG_SPI=y

CONFIG_USE_DT_CODE_PARTITION=y
CONFIG_BUILD_OUTPUT_UF2=y
CONFIG_MPU_ALLOW_FLASH_WRITE=y
CONFIG_NVS=y
CONFIG_SETTINGS_NVS=y
CONFIG_FLASH=y
CONFIG_FLASH_PAGE_LAYOUT=y
CONFIG_FLASH_MAP=y

CONFIG_CLOCK_CONTROL_NRF_K32SRC_XTAL=y
CONFIG_CLOCK_CONTROL_NRF_K32SRC_30PPM=y

CONFIG_EC11=y
CONFIG_EC11_TRIGGER_GLOBAL_THREAD=y

CONFIG_ZMK_SLEEP=y

CONFIG_ZMK_USB=y
CONFIG_ZMK_BLE=y

# enable display drivers
CONFIG_ZMK_DISPLAY=y

#EXT POWER
CONFIG_ZMK_EXT_POWER=y

#BLE-passkey
CONFIG_ZMK_BLE_PASSKEY_ENTRY=n

#BLE-clean
CONFIG_ZMK_BLE_CLEAR_BONDS_ON_START=n

#usb-name
CONFIG_USB_DEVICE_MANUFACTURER="sofle"

CONFIG_BT_CTLR_TX_PWR_PLUS_8=y
CONFIG_ZMK_HID_REPORT_TYPE_NKRO=n
#CONFIG_ZMK_HID_CONSUMER_REPORT_USAGES_BASIC=y

CONFIG_ZMK_POINTING=y
```
